## src/wheel_loader/operator_interface/Kconfig
```kconfig
menuconfig WHEEL_LOADER_OPERATOR_INTERFACE
	bool "operator_interface"
	default n
	---help---
		Enable support for operator interface module
		Provides interface for operator inputs via RC and MAVLink.
```
